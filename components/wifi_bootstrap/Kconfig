## components/wifi_bootstrap/Kconfig
```kconfig
menu "Wi-Fi Bootstrap"

config WIFI_BOOTSTRAP_ENABLE
    bool "Enable Wi-Fi bootstrap"
    default n
    help
        Enable station-mode Wi-Fi bootstrap for developer-configured connectivity.

if WIFI_BOOTSTRAP_ENABLE

config WIFI_BOOTSTRAP_SSID
    string "Wi-Fi SSID"
    default ""
    help
        Network SSID used by station-mode Wi-Fi.

config WIFI_BOOTSTRAP_PASSWORD
    string "Wi-Fi password"
    default ""
    help
        Network password used by station-mode Wi-Fi. Leave empty only for open networks.

config WIFI_BOOTSTRAP_STARTUP_TIMEOUT_MS
    int "Startup connect window (ms)"
    range 0 60000
    default 5000
    help
        Maximum boot-time wait for first Wi-Fi connection. Set 0 to skip waiting.

endif

endmenu
```

## main/Kconfig.projbuild
```kconfig
menu "Water Level Controller"

config WATER_LEVEL_LED_GPIO
    int "On-board LED GPIO"
    range -1 48
    default 38
    help
        Select the GPIO that drives the on-board LED. Use -1 to disable LED control.
        The LOLIN S3 boards route the built-in RGB LED to GPIO38.

config WATER_LEVEL_LED_BRIGHTNESS
    int "RGB LED brightness"
    range 1 255
    default 32
    help
        Brightness applied to the RGB indicator LED (1-255). Lower values reduce power draw.

config WATER_LEVEL_RELAY_GPIO
    int "Relay control GPIO"
    range -1 48
    default 5
    help
        Select the GPIO connected to the relay driver. Use -1 to disable the relay output.

config WATER_LEVEL_SENSOR_ADC_CHANNEL
    int "ADC channel for XKC-Y23A sensor"
    range 0 7
    default 0
    help
        Choose the ADC1 channel wired to the XKC-Y23A analog output. Channel numbers map to ADC1_CH0..CH7.

config WATER_LEVEL_SENSOR_DIGITAL_INPUT
    bool "Use digital-output water level sensor"
    default n
    help
        Enable this if the sensor exposes a digital high/low output instead of an analog voltage.
        The firmware will sample the GPIO directly and skip ADC reads.

config WATER_LEVEL_SENSOR_DIGITAL_ACTIVE_HIGH
    bool "Digital sensor active-high"
    depends on WATER_LEVEL_SENSOR_DIGITAL_INPUT
    default y
    help
        Leave enabled if a logic HIGH indicates water-present. Disable if the sensor asserts LOW
        when water is detected.

choice WATER_LEVEL_SENSOR_DIGITAL_PULL
    prompt "Digital sensor pull resistor"
    depends on WATER_LEVEL_SENSOR_DIGITAL_INPUT
    default WATER_LEVEL_SENSOR_DIGITAL_PULL_NONE

config WATER_LEVEL_SENSOR_DIGITAL_PULL_NONE
    bool "No pull"

config WATER_LEVEL_SENSOR_DIGITAL_PULL_UP
    bool "Pull-up"

config WATER_LEVEL_SENSOR_DIGITAL_PULL_DOWN
    bool "Pull-down"

endchoice

config WATER_LEVEL_SENSOR_SAMPLE_COUNT
    int "Samples per reading"
    range 1 64
    default 8
    help
        Number of ADC samples to average for each measurement.

config WATER_LEVEL_SENSOR_THRESHOLD_MV
    int "Dry threshold (mV)"
    range 0 3300
    default 1200
    help
        If the averaged sensor voltage is below this threshold, the firmware considers the tank level low.

config WATER_LEVEL_SENSOR_DISCONNECT_MV
    int "Sensor disconnect threshold (mV)"
    range 0 500
    default 50
    help
        Voltages below this level are treated as a disconnected or faulty sensor and will raise a fault event.

config WATER_LEVEL_POLL_PERIOD_MS
    int "Poll period (ms)"
    range 100 10000
    default 1000
    help
        Delay between successive sensor readings.

config DOSER_COUNT
    int "Number of dosing channels"
    range 2 2
    default 2
    help
        Fixed number of dosing channels managed by the firmware. The current design supports
        exactly two channels (doser1..doser2).

config DOSER1_GPIO
    int "Doser #1 relay GPIO"
    range -1 48
    default 7
    help
        GPIO driving the relay or MOSFET for doser1. Set to -1 to disable this channel.

config DOSER2_GPIO
    int "Doser #2 relay GPIO"
    range -1 48
    default 15
    help
        GPIO driving the relay or MOSFET for doser2. Set to -1 to disable this channel.

config DOSER_MS_PER_ML
    int "Milliseconds per milliliter"
    range 1 10000
    default 2000
    help
        Conversion between requested milliliters and actuator on-time. The default of 2000ms maps
        to 1ml -> 2s.

endmenu
```

## sdkconfig.defaults
```kconfig
CONFIG_IDF_TARGET="esp32s3"
# Safe GPIOs to use for esp32s3: 4, 5, 6, 7, 15, 16
CONFIG_IDF_TARGET_ESP32S3=y
CONFIG_WATER_LEVEL_LED_GPIO=38
CONFIG_WATER_LEVEL_LED_BRIGHTNESS=100
CONFIG_WATER_LEVEL_RELAY_GPIO=5
CONFIG_WATER_LEVEL_SENSOR_ADC_CHANNEL=0
CONFIG_WATER_LEVEL_SENSOR_DIGITAL_INPUT=y
CONFIG_WATER_LEVEL_SENSOR_DIGITAL_ACTIVE_HIGH=y
CONFIG_WATER_LEVEL_SENSOR_DIGITAL_PULL_NONE=y
CONFIG_WATER_LEVEL_SENSOR_SAMPLE_COUNT=8
CONFIG_WATER_LEVEL_SENSOR_THRESHOLD_MV=3000
CONFIG_WATER_LEVEL_SENSOR_DISCONNECT_MV=1000
CONFIG_WATER_LEVEL_POLL_PERIOD_MS=200
CONFIG_DOSER_COUNT=2
CONFIG_DOSER1_GPIO=7
CONFIG_DOSER2_GPIO=15
CONFIG_DOSER_MS_PER_ML=2000
```
